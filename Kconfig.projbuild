## Kconfig.projbuild
```kconfig
menu "Pool Pump Controller"

    menu "WiFi Configuration"
        config POOL_PUMP_WIFI_SSID
            string "WiFi SSID"
            default ""
            help
                WiFi network name. Leave empty to require BLE provisioning.

        config POOL_PUMP_WIFI_PASSWORD
            string "WiFi Password"
            default ""
            help
                WiFi network password. Leave empty to require BLE provisioning.
    endmenu

    menu "Price API Configuration"
        config POOL_PUMP_PRICE_API_ENDPOINT
            string "Electricity price API endpoint"
            default "https://api.energidataservice.dk/dataset/Elspotprices"
            help
                Endpoint that returns day-ahead electricity price data.

        config POOL_PUMP_PRICE_REGION
            string "Price region"
            default "DK1"
            help
                Nordpool price region (e.g., DK1, DK2, SE3, NO1).
    endmenu

endmenu
```

## sdkconfig.defaults
```kconfig
# Flash configuration
CONFIG_ESPTOOLPY_FLASHSIZE_4MB=y

# Bluetooth configuration
CONFIG_BT_ENABLED=y
CONFIG_BT_BLUEDROID_ENABLED=y
CONFIG_BT_CONTROLLER_ENABLED=y
CONFIG_BTDM_CTRL_MODE_BLE_ONLY=y
CONFIG_BT_BLE_ENABLED=y
CONFIG_BT_GATTS_ENABLE=y
```
